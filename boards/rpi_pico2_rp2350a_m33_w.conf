## boards/rpi_pico2_rp2350a_m33_w.conf
```kconfig
# SPDX-License-Identifier: MIT
#
# Debugprobe Zephyr Port - Board configuration for Raspberry Pi Pico 2 W (RP2350)
#

# Flash operations for serial number
CONFIG_FLASH=y
CONFIG_FLASH_PAGE_LAYOUT=y

# PIO support (RP2350 has 3 PIO blocks)
CONFIG_PIO_RPI_PICO=y
```

## boards/rpi_pico_rp2040_w.conf
```kconfig
# SPDX-License-Identifier: MIT
#
# Debugprobe Zephyr Port - Board configuration for Raspberry Pi Pico W
#

# Flash operations for serial number
CONFIG_FLASH=y
CONFIG_FLASH_PAGE_LAYOUT=y

# PIO support
CONFIG_PIO_RPI_PICO=y
```
